/* USER CODE BEGIN Header */
/**
  ******************************************************************************
  * @file           : main.c
  * @brief          : Main program body
  ******************************************************************************
  * @attention
  *
  * Copyright (c) 2025 STMicroelectronics.
  * All rights reserved.
  *
  * This software is licensed under terms that can be found in the LICENSE file
  * in the root directory of this software component.
  * If no LICENSE file comes with this software, it is provided AS-IS.
  *
  ******************************************************************************
  */
/* USER CODE END Header */
/* Includes ------------------------------------------------------------------*/
#include "main.h"

/* Private includes ----------------------------------------------------------*/
/* USER CODE BEGIN Includes */
#include <stdio.h>
/* USER CODE END Includes */

/* Private typedef -----------------------------------------------------------*/
/* USER CODE BEGIN PTD */

/* USER CODE END PTD */

/* Private define ------------------------------------------------------------*/
/* USER CODE BEGIN PD */
#define INA219_ADDRESS (0x40<<1 )
#define REG_SHUNT_VOLTAGE   0x01
#define REG_BUS_VOLTAGE		0x02
#define REG_POWER           0x03
#define REG_CURRENT         0x04
#define REG_CALIBRATION		0x05

// INA219 calibration for 33.3 mΩ shunt, 10A range
#define INA219_CAL_VALUE     0x0C00
#define INA219_CURRENT_LSB   0.0004f   // A per bit (0.4 mA)
#define INA219_POWER_LSB     (20.0f * INA219_CURRENT_LSB) // 0.008 W per bit





/* USER CODE END PD */

/* Private macro -------------------------------------------------------------*/
/* USER CODE BEGIN PM */

/* USER CODE END PM */

/* Private variables ---------------------------------------------------------*/
UART_HandleTypeDef hlpuart1;
UART_HandleTypeDef huart2;

TIM_HandleTypeDef htim2;
TIM_HandleTypeDef htim22;

/* USER CODE BEGIN PV */
uint8_t packet[4] = {0};  // Buffer for packet
uint8_t idx = 0;          // Index for packet building
uint8_t rxByte = 0;       // Single byte for IT reception

#define MIN_PULSE   1000   // µs
#define NEUTRAL     1500   // µs
#define MAX_PULSE   2000   // µs

uint32_t lastMotorCommandTime = 0;
const uint32_t MOTOR_TIMEOUT = 1000; // ms


I2C_HandleTypeDef hi2c1; // Generated by CubeMX


float bus_voltage = 0.0f;
static uint32_t sensorTick = 0;
int16_t raw_current = 0;
float current_mA = 0.0f;

static volatile uint8_t uart2_tx_busy = 0;

typedef struct __attribute__((packed)) {
    uint8_t header;     // 0x55
    uint16_t bus_raw;   // e.g. 0x5FC2
    int16_t cur_raw;   // e.g. 0x00D0
    uint8_t end;        // '\n'
} TelemetryFrame;

static TelemetryFrame tx_frame;

/* USER CODE END PV */

/* Private function prototypes -----------------------------------------------*/
void SystemClock_Config(void);
static void MX_GPIO_Init(void);
static void MX_USART2_UART_Init(void);
static void MX_LPUART1_UART_Init(void);
static void MX_TIM2_Init(void);
static void MX_TIM22_Init(void);
static void MX_I2C1_Init(void); // Prototype added to fix 'implicit declaration'
/* USER CODE BEGIN PFP */
void handleESC(uint8_t dir, uint8_t speedA, uint8_t speedB);
void UART_ProcessByte(uint8_t byte);
uint16_t mapValue(uint16_t x, uint16_t in_min, uint16_t in_max, uint16_t out_min, uint16_t out_max);
uint16_t constrainValue(uint16_t x, uint16_t min_val, uint16_t max_val);
void ESC_SetPulse_us(TIM_HandleTypeDef *htim, uint32_t Channel, uint32_t pulse_us);
void UART2_SendTelemetry(uint16_t bus_raw, int16_t cur_raw);
/* USER CODE END PFP */

/* Private user code ---------------------------------------------------------*/
/* USER CODE BEGIN 0 */

/* USER CODE END 0 */

/**
  * @brief  The application entry point.
  * @retval int
  */
int main(void)
{
  HAL_Init();
  SystemClock_Config();

  /* Initialize all configured peripherals */
  MX_GPIO_Init();
  MX_USART2_UART_Init();
  MX_LPUART1_UART_Init();
  MX_TIM2_Init();
  MX_TIM22_Init();
  MX_I2C1_Init(); //

  HAL_Delay(50);



  // Debug helper: check device ready
  if (HAL_I2C_IsDeviceReady(&hi2c1, INA219_ADDRESS, 3, 1000) != HAL_OK) {
      printf("INA219 NOT READY at 0x%02X (HAL_I2C_IsDeviceReady failed)\r\n", (INA219_ADDRESS>>1));
      while(1);
  } else {
      printf("INA219 READY at 0x%02X\r\n", (INA219_ADDRESS>>1));
  }



  // Write calibration register (2 bytes) using Mem_Write
  {
      uint8_t cal_buf[2] = { 0x10, 0x00 }; // 0x1000 example calibration
      if (HAL_I2C_Mem_Write(&hi2c1, INA219_ADDRESS, REG_CALIBRATION,
                            I2C_MEMADD_SIZE_8BIT, cal_buf, 2, 1000) != HAL_OK) {
    	  uint32_t err = HAL_I2C_GetError(&hi2c1);
    	  printf("Cal write failed (I2C err=0x%08lX)\r\n", err);

      } else {
          printf("Cal written OK\r\n");
      }
  }


  /* USER CODE BEGIN 2 */
  HAL_TIM_PWM_Start(&htim2, TIM_CHANNEL_2);
  HAL_TIM_PWM_Start(&htim22, TIM_CHANNEL_1);
  HAL_TIM_PWM_Start(&htim22, TIM_CHANNEL_2);

  // Calibration: INA219 registers are Big-Endian (MSB first)
  uint8_t cal_data[3];
  cal_data[0] = REG_CALIBRATION;
  cal_data[1] = 0x10; // MSB
  cal_data[2] = 0x00; // LSB
  HAL_I2C_Master_Transmit(&hi2c1, INA219_ADDRESS, cal_data, 3, 100);

  HAL_UART_Receive_IT(&huart2, &rxByte, 1);
  handleESC(0, 0, 0);
  /* USER CODE END 2 */

  /* USER CODE BEGIN WHILE */
    while (1)
    {
      // Motor Safety Timeout
      if (HAL_GetTick() - lastMotorCommandTime > MOTOR_TIMEOUT) {
        handleESC(0, 0, 0);
      }

      // Sensor Read & Telemetry Loop (100ms)
      if (HAL_GetTick() - sensorTick > 100) {
          sensorTick = HAL_GetTick();
          uint8_t data[2];
          uint16_t v_temp = 0;
          int16_t i_temp = 0;

          // 1. Read Bus Voltage
          if (HAL_I2C_Mem_Read(&hi2c1, INA219_ADDRESS, REG_BUS_VOLTAGE,
                               I2C_MEMADD_SIZE_8BIT, data, 2, 100) == HAL_OK) {
              v_temp = (data[0] << 8) | data[1];
          }

          // 2. Read Current
          if (HAL_I2C_Mem_Read(&hi2c1, INA219_ADDRESS, REG_CURRENT,
                               I2C_MEMADD_SIZE_8BIT, data, 2, 100) == HAL_OK) {
              i_temp = (int16_t)((data[0] << 8) | data[1]);
          }

          // 3. Send via USART2 (TX)
          UART2_SendTelemetry(v_temp, i_temp);

          // Optional: Keep LPUART1 for human-readable debugging
          printf("Sent Telemetry: V=0x%04X I=0x%04X\r\n", v_temp, i_temp);
      }
      /* USER CODE END 3 */
    }
  /* USER CODE END 3 */
}

/**
  * @brief System Clock Configuration
  * @retval None
  */
void SystemClock_Config(void)
{
  RCC_OscInitTypeDef RCC_OscInitStruct = {0};
  RCC_ClkInitTypeDef RCC_ClkInitStruct = {0};
  RCC_PeriphCLKInitTypeDef PeriphClkInit = {0};

  /** Configure the main internal regulator output voltage
  */
  __HAL_PWR_VOLTAGESCALING_CONFIG(PWR_REGULATOR_VOLTAGE_SCALE1);

  /** Initializes the RCC Oscillators according to the specified parameters
  * in the RCC_OscInitTypeDef structure.
  */
  RCC_OscInitStruct.OscillatorType = RCC_OSCILLATORTYPE_HSI;  // Change to HSI
  RCC_OscInitStruct.HSIState = RCC_HSI_ON;
  RCC_OscInitStruct.HSICalibrationValue = RCC_HSICALIBRATION_DEFAULT;  // Factory trim
  RCC_OscInitStruct.PLL.PLLState = RCC_PLL_NONE;
  if (HAL_RCC_OscConfig(&RCC_OscInitStruct) != HAL_OK)
  {
    Error_Handler();
  }

  /** Initializes the CPU, AHB and APB buses clocks
  */
  RCC_ClkInitStruct.ClockType = RCC_CLOCKTYPE_HCLK|RCC_CLOCKTYPE_SYSCLK
                              |RCC_CLOCKTYPE_PCLK1|RCC_CLOCKTYPE_PCLK2;
  RCC_ClkInitStruct.SYSCLKSource = RCC_SYSCLKSOURCE_HSI;  // HSI as source
  RCC_ClkInitStruct.AHBCLKDivider = RCC_SYSCLK_DIV1;
  RCC_ClkInitStruct.APB1CLKDivider = RCC_HCLK_DIV1;
  RCC_ClkInitStruct.APB2CLKDivider = RCC_HCLK_DIV1;

  if (HAL_RCC_ClockConfig(&RCC_ClkInitStruct, FLASH_LATENCY_0) != HAL_OK)
  {
    Error_Handler();
  }
  PeriphClkInit.PeriphClockSelection = RCC_PERIPHCLK_USART2|RCC_PERIPHCLK_LPUART1;
  PeriphClkInit.Usart2ClockSelection = RCC_USART2CLKSOURCE_PCLK1;
  PeriphClkInit.Lpuart1ClockSelection = RCC_LPUART1CLKSOURCE_PCLK1;
  if (HAL_RCCEx_PeriphCLKConfig(&PeriphClkInit) != HAL_OK)
  {
    Error_Handler();
  }
}

/**
  * @brief LPUART1 Initialization Function
  * @param None
  * @retval None
  */
static void MX_LPUART1_UART_Init(void)
{

  /* USER CODE BEGIN LPUART1_Init 0 */

  /* USER CODE END LPUART1_Init 0 */

  /* USER CODE BEGIN LPUART1_Init 1 */

  /* USER CODE END LPUART1_Init 1 */
  hlpuart1.Instance = LPUART1;
  hlpuart1.Init.BaudRate = 115200;
  hlpuart1.Init.WordLength = UART_WORDLENGTH_8B;
  hlpuart1.Init.StopBits = UART_STOPBITS_1;
  hlpuart1.Init.Parity = UART_PARITY_NONE;
  hlpuart1.Init.Mode = UART_MODE_TX_RX;
  hlpuart1.Init.HwFlowCtl = UART_HWCONTROL_NONE;
  hlpuart1.Init.OneBitSampling = UART_ONE_BIT_SAMPLE_DISABLE;
  hlpuart1.AdvancedInit.AdvFeatureInit = UART_ADVFEATURE_NO_INIT;
  if (HAL_UART_Init(&hlpuart1) != HAL_OK)
  {
    Error_Handler();
  }
  /* USER CODE BEGIN LPUART1_Init 2 */

  /* USER CODE END LPUART1_Init 2 */

}

/**
  * @brief USART2 Initialization Function
  * @param None
  * @retval None
  */
static void MX_USART2_UART_Init(void)
{

  /* USER CODE BEGIN USART2_Init 0 */

  /* USER CODE END USART2_Init 0 */

  /* USER CODE BEGIN USART2_Init 1 */

  /* USER CODE END USART2_Init 1 */
  huart2.Instance = USART2;
  huart2.Init.BaudRate = 115200;
  huart2.Init.WordLength = UART_WORDLENGTH_8B;
  huart2.Init.StopBits = UART_STOPBITS_1;
  huart2.Init.Parity = UART_PARITY_NONE;
  huart2.Init.Mode = UART_MODE_TX_RX;
  huart2.Init.HwFlowCtl = UART_HWCONTROL_NONE;
  huart2.Init.OverSampling = UART_OVERSAMPLING_16;
  huart2.Init.OneBitSampling = UART_ONE_BIT_SAMPLE_DISABLE;
  huart2.AdvancedInit.AdvFeatureInit = UART_ADVFEATURE_NO_INIT;
  if (HAL_UART_Init(&huart2) != HAL_OK)
  {
    Error_Handler();
  }
  /* USER CODE BEGIN USART2_Init 2 */

  /* USER CODE END USART2_Init 2 */

}

/**
  * @brief TIM2 Initialization Function
  * @param None
  * @retval None
  */

static void MX_I2C1_Init(void)
{
  hi2c1.Instance = I2C1;
  hi2c1.Init.Timing = 0x00300F38; // Standard Mode 100kHz @ 16MHz HSI
  hi2c1.Init.OwnAddress1 = 0;
  hi2c1.Init.AddressingMode = I2C_ADDRESSINGMODE_7BIT;
  hi2c1.Init.DualAddressMode = I2C_DUALADDRESS_DISABLE;
  hi2c1.Init.OwnAddress2 = 0;
  hi2c1.Init.OwnAddress2Masks = I2C_OA2_NOMASK;
  hi2c1.Init.GeneralCallMode = I2C_GENERALCALL_DISABLE;
  hi2c1.Init.NoStretchMode = I2C_NOSTRETCH_DISABLE;
  if (HAL_I2C_Init(&hi2c1) != HAL_OK)
  {
    Error_Handler();
  }
  /** Configure Analogue filter */
  if (HAL_I2CEx_ConfigAnalogFilter(&hi2c1, I2C_ANALOGFILTER_ENABLE) != HAL_OK)
  {
    Error_Handler();
  }
  /** Configure Digital filter */
  if (HAL_I2CEx_ConfigDigitalFilter(&hi2c1, 0) != HAL_OK)
  {
    Error_Handler();
  }
}
static void MX_TIM2_Init(void)
{

  /* USER CODE BEGIN TIM2_Init 0 */

  /* USER CODE END TIM2_Init 0 */

  TIM_ClockConfigTypeDef sClockSourceConfig = {0};
  TIM_MasterConfigTypeDef sMasterConfig = {0};
  TIM_OC_InitTypeDef sConfigOC = {0};

  /* USER CODE BEGIN TIM2_Init 1 */

  /* USER CODE END TIM2_Init 1 */
  htim2.Instance = TIM2;
  htim2.Init.Prescaler = 0;
  htim2.Init.CounterMode = TIM_COUNTERMODE_UP;
  htim2.Init.Period = 319999;
  htim2.Init.ClockDivision = TIM_CLOCKDIVISION_DIV1;
  htim2.Init.AutoReloadPreload = TIM_AUTORELOAD_PRELOAD_DISABLE;
  if (HAL_TIM_Base_Init(&htim2) != HAL_OK)
  {
    Error_Handler();
  }
  sClockSourceConfig.ClockSource = TIM_CLOCKSOURCE_INTERNAL;
  if (HAL_TIM_ConfigClockSource(&htim2, &sClockSourceConfig) != HAL_OK)
  {
    Error_Handler();
  }
  if (HAL_TIM_PWM_Init(&htim2) != HAL_OK)
  {
    Error_Handler();
  }
  sMasterConfig.MasterOutputTrigger = TIM_TRGO_RESET;
  sMasterConfig.MasterSlaveMode = TIM_MASTERSLAVEMODE_DISABLE;
  if (HAL_TIMEx_MasterConfigSynchronization(&htim2, &sMasterConfig) != HAL_OK)
  {
    Error_Handler();
  }
  sConfigOC.OCMode = TIM_OCMODE_PWM1;
  sConfigOC.Pulse = 0;
  sConfigOC.OCPolarity = TIM_OCPOLARITY_HIGH;
  sConfigOC.OCFastMode = TIM_OCFAST_DISABLE;
  if (HAL_TIM_PWM_ConfigChannel(&htim2, &sConfigOC, TIM_CHANNEL_2) != HAL_OK)
  {
    Error_Handler();
  }
  /* USER CODE BEGIN TIM2_Init 2 */

  /* USER CODE END TIM2_Init 2 */
  HAL_TIM_MspPostInit(&htim2);

}

/**
  * @brief TIM22 Initialization Function
  * @param None
  * @retval None
  */
static void MX_TIM22_Init(void)
{

  /* USER CODE BEGIN TIM22_Init 0 */

  /* USER CODE END TIM22_Init 0 */

  TIM_ClockConfigTypeDef sClockSourceConfig = {0};
  TIM_MasterConfigTypeDef sMasterConfig = {0};
  TIM_OC_InitTypeDef sConfigOC = {0};

  /* USER CODE BEGIN TIM22_Init 1 */

  /* USER CODE END TIM22_Init 1 */
  htim22.Instance = TIM22;
  htim22.Init.Prescaler = 0;
  htim22.Init.CounterMode = TIM_COUNTERMODE_UP;
  htim22.Init.Period = 319999;
  htim22.Init.ClockDivision = TIM_CLOCKDIVISION_DIV1;
  htim22.Init.AutoReloadPreload = TIM_AUTORELOAD_PRELOAD_DISABLE;
  if (HAL_TIM_Base_Init(&htim22) != HAL_OK)
  {
    Error_Handler();
  }
  sClockSourceConfig.ClockSource = TIM_CLOCKSOURCE_INTERNAL;
  if (HAL_TIM_ConfigClockSource(&htim22, &sClockSourceConfig) != HAL_OK)
  {
    Error_Handler();
  }
  if (HAL_TIM_PWM_Init(&htim22) != HAL_OK)
  {
    Error_Handler();
  }
  sMasterConfig.MasterOutputTrigger = TIM_TRGO_RESET;
  sMasterConfig.MasterSlaveMode = TIM_MASTERSLAVEMODE_DISABLE;
  if (HAL_TIMEx_MasterConfigSynchronization(&htim22, &sMasterConfig) != HAL_OK)
  {
    Error_Handler();
  }
  sConfigOC.OCMode = TIM_OCMODE_PWM1;
  sConfigOC.Pulse = 0;
  sConfigOC.OCPolarity = TIM_OCPOLARITY_HIGH;
  sConfigOC.OCFastMode = TIM_OCFAST_DISABLE;
  if (HAL_TIM_PWM_ConfigChannel(&htim22, &sConfigOC, TIM_CHANNEL_1) != HAL_OK)
  {
    Error_Handler();
  }
  if (HAL_TIM_PWM_ConfigChannel(&htim22, &sConfigOC, TIM_CHANNEL_2) != HAL_OK)
  {
    Error_Handler();
  }
  /* USER CODE BEGIN TIM22_Init 2 */

  /* USER CODE END TIM22_Init 2 */
  HAL_TIM_MspPostInit(&htim22);

}

/**
  * @brief GPIO Initialization Function
  * @param None
  * @retval None
  */
static void MX_GPIO_Init(void)
{
/* USER CODE BEGIN MX_GPIO_Init_1 */
/* USER CODE END MX_GPIO_Init_1 */

  /* GPIO Ports Clock Enable */
  __HAL_RCC_GPIOC_CLK_ENABLE();
  __HAL_RCC_GPIOH_CLK_ENABLE();
  __HAL_RCC_GPIOA_CLK_ENABLE();
  __HAL_RCC_GPIOB_CLK_ENABLE();

/* USER CODE BEGIN MX_GPIO_Init_2 */
/* USER CODE END MX_GPIO_Init_2 */
}

/* USER CODE BEGIN 4 */
uint16_t mapValue(uint16_t x, uint16_t in_min, uint16_t in_max, uint16_t out_min, uint16_t out_max)
{
    return (x - in_min) * (out_max - out_min) / (in_max - in_min) + out_min;
}

uint16_t constrainValue(uint16_t x, uint16_t min_val, uint16_t max_val)
{
    if (x < min_val) return min_val;
    if (x > max_val) return max_val;
    return x;
}

void ESC_SetPulse_us(TIM_HandleTypeDef *htim, uint32_t Channel, uint32_t pulse_us)
{
      // Get timer parameters from htim struct
      uint32_t psc = htim->Init.Prescaler;
      uint32_t arr = htim->Init.Period;

      // Try to determine timer clock in Hz.
      // If you know your timer clock constant at compile time, prefer using that value.
      // For example with MSI=2,097,000 and APB dividers=1 => timer_clk = 2097000
      const uint64_t timer_clk_hz = 16000000ULL; // <-- update if you change system clock

      // compare = pulse_us * (timer_clk_hz / (psc+1)) / 1e6
      uint64_t ticks = ( (uint64_t)pulse_us * timer_clk_hz ) / ( (uint64_t)(psc + 1) * 1000000ULL );

      // clamp: ensure compare <= ARR
      if (ticks > arr) ticks = arr;

      __HAL_TIM_SET_COMPARE(htim, Channel, (uint32_t)ticks);
  }


void handleESC(uint8_t dir, uint8_t speedA, uint8_t speedB)
{

    speedA = constrainValue(speedA, 0, 255);
    speedB = constrainValue(speedB, 0, 255);

    uint16_t pulseL = NEUTRAL;
    uint16_t pulseR = NEUTRAL;

    switch (dir) {
    	case 0:  // Stop - ADD THIS CASE
			pulseL = NEUTRAL;
			pulseR = NEUTRAL;
			break;
        case 1:  // Forward
            pulseL = NEUTRAL + mapValue(speedA, 0, 255, 0, 500);
            pulseR = NEUTRAL + mapValue(speedB, 0, 255, 0, 500);
            break;
        case 2:  // Backward
            pulseL = NEUTRAL - mapValue(speedA, 0, 255, 0, 500);
            pulseR = NEUTRAL - mapValue(speedB, 0, 255, 0, 500);
            break;
        case 3:  // Pivot CW
            pulseL = NEUTRAL + mapValue(speedA, 0, 255, 0, 500);
            pulseR = NEUTRAL - mapValue(speedB, 0, 255, 0, 500);
            break;
        case 4:  // Pivot CCW
            pulseL = NEUTRAL - mapValue(speedA, 0, 255, 0, 500);
            pulseR = NEUTRAL + mapValue(speedB, 0, 255, 0, 500);
            break;
    }

    pulseL = constrainValue(pulseL, MIN_PULSE, MAX_PULSE);
    pulseR = constrainValue(pulseR, MIN_PULSE, MAX_PULSE);

    // Example: ESCs on TIM22 CH1 (PB4) and CH2 (PB5)
    ESC_SetPulse_us(&htim22, TIM_CHANNEL_1, pulseL);
    ESC_SetPulse_us(&htim22, TIM_CHANNEL_2, pulseR);
//    printf("PulseA %X PulseB %X \n",pulseL,pulseR);
}

// New function for byte-by-byte processing (called from IT callback)
void UART_ProcessByte(uint8_t byte) {
  if (idx == 0) {
    // Waiting for header
    if (byte == 0xAA) {
      packet[idx++] = byte;
      // printf("Motor packet started\n");  // Uncomment only if needed, but avoid for production
    } else {
      // printf("Invalid byte (no header): 0x%02X\n", byte);  // Avoid blocking print
    }
  } else {
    packet[idx++] = byte;
    if (idx == 4) {
      // Full packet received - process it
      handleESC(packet[1], packet[2], packet[3]);
      lastMotorCommandTime = HAL_GetTick();  // Update timeout timer

      // Optional: Debug print FULL packet only (do this sparingly, or buffer for main loop)
//      printf("Full packet: 0x%02X 0x%02X 0x%02X 0x%02X\n", packet[0], packet[1], packet[2], packet[3]);

      idx = 0;  // Reset for next packet
    }
  }
}
void Data_debug(uint8_t byte) {
	printf("0x%02X\n", byte);
}

// UART RX complete callback (auto-called by HAL on byte reception)
void HAL_UART_RxCpltCallback(UART_HandleTypeDef *huart) {
  if (huart->Instance == USART2) {
    UART_ProcessByte(rxByte);
//	  Data_debug(rxByte);
    // Restart listening for the next byte
    HAL_UART_Receive_IT(&huart2, &rxByte, 1);
  }
}
void HAL_UART_ErrorCallback(UART_HandleTypeDef *huart) {
  if (huart->Instance == USART2) {
    uint32_t isr = huart->Instance->ISR;  // Read raw flags
    printf("UART Error: %lu | ISR: 0x%08lX\n", huart->ErrorCode, isr);

    // Clear errors (including ORE by reading RDR)
    if (isr & USART_ISR_ORE) {
      volatile uint8_t dummy = huart->Instance->RDR;
      (void)dummy;
    }
    __HAL_UART_CLEAR_FLAG(huart, UART_CLEAR_OREF | UART_CLEAR_NEF | UART_CLEAR_PEF | UART_CLEAR_FEF);

    HAL_UART_Receive_IT(&huart2, &rxByte, 1);
  }
}
int _write(int file, char *ptr, int len)
{
    HAL_UART_Transmit(&hlpuart1, (uint8_t*)ptr, len, 50);
    return len;
}

/* USER CODE BEGIN 4 */
void HAL_I2C_MspInit(I2C_HandleTypeDef* hi2c)
{
  GPIO_InitTypeDef GPIO_InitStruct = {0};
  if(hi2c->Instance==I2C1)
  {
    __HAL_RCC_GPIOB_CLK_ENABLE();
    __HAL_RCC_I2C1_CLK_ENABLE();

    /**I2C1 GPIO Configuration
    PB6     ------> I2C1_SCL
    PB7     ------> I2C1_SDA
    */
    GPIO_InitStruct.Pin = GPIO_PIN_6|GPIO_PIN_7;
    GPIO_InitStruct.Mode = GPIO_MODE_AF_OD;
    GPIO_InitStruct.Pull = GPIO_PULLUP;
    GPIO_InitStruct.Speed = GPIO_SPEED_FREQ_VERY_HIGH;
    GPIO_InitStruct.Alternate = GPIO_AF1_I2C1;
    HAL_GPIO_Init(GPIOB, &GPIO_InitStruct);
  }
}

void INA219_WriteCalibration(void)
{
    uint8_t buf[2];
    buf[0] = (INA219_CAL_VALUE >> 8) & 0xFF;
    buf[1] = INA219_CAL_VALUE & 0xFF;

    HAL_I2C_Mem_Write(&hi2c1,
                      INA219_ADDRESS,
                      REG_CALIBRATION,
                      I2C_MEMADD_SIZE_8BIT,
                      buf, 2, 1000);
}


void UART2_SendTelemetry(uint16_t bus_raw, int16_t cur_raw)
{
    // If UART is still sending the previous frame, skip this one
    if (uart2_tx_busy) return;

    tx_frame.header  = 0x55;

    // Explicitly swap bytes if you want Big-Endian (Standard for telemetry)
    // If your receiver handles Little-Endian, you can just do: tx_frame.bus_raw = bus_raw;
    tx_frame.bus_raw = ((bus_raw << 8) & 0xFF00) | ((bus_raw >> 8) & 0x00FF);
    tx_frame.cur_raw = ((cur_raw << 8) & 0xFF00) | ((cur_raw >> 8) & 0x00FF);

    tx_frame.end     = 0x0A; // '\n'

    uart2_tx_busy = 1;
    HAL_UART_Transmit_IT(&huart2, (uint8_t *)&tx_frame, sizeof(TelemetryFrame));
}

void HAL_UART_TxCpltCallback(UART_HandleTypeDef *huart)
{
    if (huart->Instance == USART2) {
        uart2_tx_busy = 0;
    }
}



/* USER CODE END 4 */

/* USER CODE END 4 */

/**
  * @brief  This function is executed in case of error occurrence.
  * @retval None
  */
void Error_Handler(void)
{
  /* USER CODE BEGIN Error_Handler_Debug */
  /* User can add his own implementation to report the HAL error return state */
  __disable_irq();
  while (1)
  {
  }
  /* USER CODE END Error_Handler_Debug */
}

#ifdef  USE_FULL_ASSERT
/**
  * @brief  Reports the name of the source file and the source line number
  *         where the assert_param error has occurred.
  * @param  file: pointer to the source file name
  * @param  line: assert_param error line source number
  * @retval None
  */
void assert_failed(uint8_t *file, uint32_t line)
{
  /* USER CODE BEGIN 6 */
  /* User can add his own implementation to report the file name and line number,
     ex: printf("Wrong parameters value: file %s on line %d\r\n", file, line) */
  /* USER CODE END 6 */
}
#endif /* USE_FULL_ASSERT */
